/* Copyright (c) 2013-2015, The Linux Foundation. All rights reserved.
 *
 * This program is free software; you can redistribute it and/or modify
 * it under the terms of the GNU General Public License version 2 and
 * only version 2 as published by the Free Software Foundation.
 *
 * This program is distributed in the hope that it will be useful,
 * but WITHOUT ANY WARRANTY; without even the implied warranty of
 * MERCHANTABILITY or FITNESS FOR A PARTICULAR PURPOSE.  See the
 * GNU General Public License for more details.
 */

&mdss_mdp {
	dsi_dual_zte_truly_td4322_5p5_fhd_cmd: qcom,mdss_dsi_zte_truly_td4322_5p5_fhd_dualmipi_cmd{
		qcom,mdss-dsi-panel-name = "zteTruly_td4322_5P2Inch";
		qcom,mdss-dsi-panel-type = "dsi_cmd_mode";
		qcom,cont-splash-enabled;
		qcom,mdss-dsi-panel-framerate = <60>;
		qcom,mdss-dsi-virtual-channel-id = <0>;
		qcom,mdss-dsi-stream = <0>;
		qcom,mdss-dsi-panel-width = <1080>;
		qcom,mdss-dsi-panel-height = <1920>;
		qcom,mdss-dsi-h-front-porch = <60>;
		qcom,mdss-dsi-h-back-porch = <60>;
		qcom,mdss-dsi-h-pulse-width = <20>;
		qcom,mdss-dsi-h-sync-skew = <0>;
		qcom,mdss-dsi-v-back-porch = <8>;
		qcom,mdss-dsi-v-front-porch = <16>;
		qcom,mdss-dsi-v-pulse-width = <2>;
		qcom,mdss-dsi-h-left-border = <0>;
		qcom,mdss-dsi-h-right-border = <0>;
		qcom,mdss-dsi-v-top-border = <0>;
		qcom,mdss-dsi-v-bottom-border = <0>;
		qcom,mdss-dsi-bpp = <24>;
		qcom,mdss-dsi-underflow-color = <0xff>;
		qcom,mdss-dsi-border-color = <0>;
		qcom,mdss-dsi-te-pin-select = <1>;
		qcom,mdss-dsi-te-dcs-command = <1>;
		qcom,mdss-dsi-te-check-enable;
		qcom,mdss-dsi-te-using-te-pin;
		qcom,mdss-dsi-h-sync-pulse = <0>;
		qcom,mdss-dsi-traffic-mode = "non_burst_sync_event";
		qcom,mdss-dsi-bllp-eof-power-mode;
		qcom,mdss-dsi-bllp-power-mode;
		qcom,mdss-pan-physical-width-dimension = <64>;
		qcom,mdss-pan-physical-height-dimension = <114>;
		qcom,mdss-dsi-lane-0-state;
		qcom,mdss-dsi-lane-1-state;
		qcom,mdss-dsi-lane-2-state;
		qcom,mdss-dsi-lane-3-state;
		qcom,mdss-dsi-panel-timings-phy-v2 = [
			23 1f 07 09 05 03 04 a0
			23 1f 07 09 05 03 04 a0
			23 1f 07 09 05 03 04 a0
			23 1f 07 09 05 03 04 a0
			23 19 08 08 05 03 04 a0];
		qcom,mdss-dsi-reset-sequence = <1 10>, <0 10>, <1 30>;
		qcom,mdss-dsi-t-clk-post = <0x06>;
		qcom,mdss-dsi-t-clk-pre = <0x2b>;
		qcom,mdss-dsi-dma-trigger = "trigger_sw";
		qcom,mdss-dsi-mdp-trigger = "none";
		qcom,mdss-dsi-wr-mem-start = <0x2c>;
		qcom,mdss-dsi-wr-mem-continue = <0x3c>;
		qcom,mdss-dsi-lp11-init;
		qcom,mdss-dsi-init-delay-us=<10000>;
		qcom,mdss-dsi-bl-pmic-control-type ="bl_ctrl_dcs";
		qcom,mdss-dsi-bl-min-level = <1>;
		qcom,mdss-dsi-bl-max-level = <255>;
		qcom,mdss-dsi-on-command = [
			39 01 00 00 00 00 05 30 00 00 02 A7
			23 01 00 00 00 00 02 B0 00
			29 01 00 00 00 00 04 B3 00 00 06
			29 01 00 00 00 00 02 B4 00
			29 01 00 00 00 00 06 B6 33 DB 80 12 00
			29 01 00 00 00 00 08 B8 57 3D 19 1E 0A 50 50
			29 01 00 00 00 00 08 B9 6F 3D 28 3C 14 C8 C8
			29 01 00 00 00 00 08 BA B5 33 41 64 23 A0 A0
			29 01 00 00 00 00 03 BB 14 14
			29 01 00 00 00 00 03 BC 37 32
			29 01 00 00 00 00 03 BD 64 32
			29 01 00 00 00 00 02 BE 04
			29 01 00 00 00 00 02 C0 00
			29 01 00 00 00 00 2e C1 04 48 10
								FF 98 47 A7
								8C 77 D9 EF
								1A FB FF FF
								FF 59 73 FF
								AF 2B 06 29
								C0 9C 0F 10
								10 10 10 10
								10 10 10 40
								02 62 02 06
								05 84 00 01
								00 01
			29 01 00 00 00 00 16 C2 01 F7 80
								05 68 08 0C
								10 00 08 30
								00 00 00 00
								00 00 00 03
								48 00
			29 01 00 00 00 00 3f C3 78 B7 8B
								78 B0 00 10
								01 00 10 00
								03 B6 00 00
								00 04 01 00
								00 02 01 03
								28 01 02 04
								02 44 84 1E
								00 1E 00 A3
								01 1E 00 1E
								00 A3 01 1E
								00 1E 00 A3
								01 3C 00 3C
								00 47 03 3B
								00 3B 00 46
								03 02 04
			29 01 00 00 00 00 15 C4 70 00 00
								00 00 00 00
								00 10 02 02
								31 01 00 00
								00 02 01 01
								01
			29 01 00 00 00 00 08 C5 08 00 00
								00 00 70 00
			29 01 00 00 00 00 40 C6 5A 02 54
								03 52 01 0E
								01 02 01 02
								00 00 00 00
								00 00 06 16
								06 5A 00 FF
								5A 85 85 00
								00 00 00 00
								00 00 00 00
								00 00 00 00
								00 00 00 00
								00 00 00 00
								00 00 00 00
								00 00 00 00
								00 00 00 00
								00 00 00 00
			/*29 01 00 00 00 00 1f C7 00 12 1B
								27 36 43 4C
								59 3D 45 51
								60 69 6E 77
								00 12 1B 27
								37 44 4C 59
								3D 46 52 61
								69 6E 77
			29 01 00 00 00 00 38 C8 11 00 11
								04 0A FC F0
								00 0E 01 07
								FC F0 00 10
								01 01 FC 00
								00 0E 04 02
								BE 00 00 0D
								01 05 DB 00
								00 10 01 01
								FC 00 00 11
								04 0A FC 00
								00 0E 00 06
								E0 00 00 10
								01 01 B9 00
			29 01 00 00 00 00 14 C9 00 00 11
								04 0A FC F0
								00 0E 01 07
								FC F0 00 10
								01 01 FC 00*/
			29 01 00 00 00 00 2c CA 1C FC CC
								A5 00 D4 E3
								D7 00 D9 E8
								D2 00 3F FF
								FB F5 34 F5
								00 00 36 FF
								00 00 ED 38
								23 FF 00 FF
								00 74 F9 46
								FF 00 00 FF
								00 35 C4 FF
			29 01 00 00 00 00 12 CB FE 77 E0
								FC 07 00 00
								00 00 00 00
								00 00 0D 00
								00 00
			29 01 00 00 00 00 02 cc 20
			29 01 00 00 00 00 27 CD 00 00 40
								00 40 00 4A
								03 E9 E9 E4
								E4 A0 A0 A0
								A0 01 00 00
								00 00 00 00
								00 00 00 00
								00 00 00 00
								00 00 00 00
								00 00 AC
			29 01 00 00 00 00 1A CE 5D 40 49
								53 59 5E 63
								68 6E 74 7E
								8A 98 A8 BB
								D0 FF 04 00
								04 04 42 00
								69 5A
			29 01 00 00 00 00 03 CF 4A 1D
			29 01 00 00 00 00 12 D0 33 59 D9
								31 01 10 10
								10 19 19 00
								00 00 00 00
								00 00
			29 01 00 00 00 00 02 D1 00
			29 01 00 00 00 00 16 D3 1B 3B BB
								77 77 77 BB
								B3 33 00 00
								6E 6E D3 D3
								33 BB F2 FD
								C6 0B
			/*29 01 00 00 00 00 08 D5 03 00 00
								02 27 02 27
			29 01 00 00 00 00 02 D6 01*/
			29 01 00 00 00 00 22 D7 F6 FF 03
								05 41 24 80
								1F C7 1F 1B
								00 0C 07 20
								00 00 00 00
								00 0C F0 1F
								00 0C 00 00
								AA 67 7E 5D
								06 00
			29 01 00 00 00 00 03 D9 00 00
			29 01 00 00 00 00 05 DD 30 06 23 65
			29 01 00 00 00 00 05 DE 00 3F FF 50
			29 01 00 00 00 00 02 EA 8F
			29 01 00 00 00 00 04 EE 41 51 00
			29 01 00 00 00 00 03 F1 00 00
			39 01 00 00 00 00 02 51 00
			39 01 00 00 00 00 02 53 0c
			39 01 00 00 00 00 02 55 02
			39 01 00 00 00 00 02 B0 03
			05 01 00 00 78 00 02 11 00
			05 01 00 00 00 00 02 29 00];
		qcom,mdss-dsi-on-command-state = "dsi_lp_mode";
		qcom,mdss-dsi-off-command =[
			39 01 00 00 00 00 02 51 00
			05 01 00 00 32 00 02 28 00
			05 01 00 00 78 00 02 10 00];
		qcom,mdss-dsi-off-command-state = "dsi_lp_mode";
	};
};
