/* Copyright (c) 2016, The Linux Foundation. All rights reserved.
 *
 * This program is free software; you can redistribute it and/or modify
 * it under the terms of the GNU General Public License version 2 and
 * only version 2 as published by the Free Software Foundation.
 *
 * This program is distributed in the hope that it will be useful,
 * but WITHOUT ANY WARRANTY; without even the implied warranty of
 * MERCHANTABILITY or FITNESS FOR A PARTICULAR PURPOSE.  See the
 * GNU General Public License for more details.
 */


/dts-v1/;

#include "msm8996pro-v1.1.dtsi"
#include "msm-pmi8996.dtsi"
#include "msm8996-mtp-fujisan.dtsi"
#include "zte-msm8996pro-v1.1-pmi8996-fujisan.dtsi"

/ {
	model = "Qualcomm Technologies, Inc. MSM 8996pro v1.1 + PMI8996 MTP";
	compatible = "qcom,msm8996-mtp", "qcom,msm8996", "qcom,mtp";
	qcom,board-id = <102 0>;
};

&i2c_8 {
	pn5xx@28 {
		nxp,pn5xx-clkreq = <&pm8994_gpios 10 0x00>;
		nxp,clk-src = "BBCLK2";
		clocks = <&clock_gcc clk_bb_clk2_pin>;
		clock-names = "bb_clk2";
	};
};
